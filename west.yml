## west.yml
```yaml
manifest:
  remotes:
    - name: nrfconnect
      url-base: https://github.com/nrfconnect
  projects:
    - name: sdk-nrf
      path: nrf
      remote: nrfconnect
      revision: v3.2.2 # or latest stable
      import: true # This pulls in Zephyr and all other modules automatically
  self:
    path: lima-node
```
